## Kconfig
```kconfig
menu "wolfSSL"

    config TLS_STACK_WOLFSSL
        bool "Include wolfSSL in ESP-TLS"
        default y
        select FREERTOS_ENABLE_BACKWARD_COMPATIBILITY
        help
            Includes wolfSSL in ESP-TLS so that it can be compiled with wolfSSL as its SSL/TLS library.

    config WOLFSSL_HAVE_ALPN
        bool "Enable ALPN (Application Layer Protocol Negotiation) in wolfSSL"
        default y

    config WOLFSSL_HAVE_OCSP
        bool "Enable OCSP (Online Certificate Status Protocol) in wolfSSL"
        default n
        help
            Enables Online Certificate Status Protocol (OCSP) within wolfSSL, which is the modern alternative
            to maintaining Certificate Revocation Lists (CRLs). Enabling this option will make esp-tls to automatically
            indicate support for OCSP when connecting as a TLS client. Server that support OCSP will forward the
            certificate's revocation status to the client and the client will automatically verify the servers certificate
            status based on the OCSP response forwarded to it.
            Note: This option enables mandatory OCSP certificate status checking using OCSP stapling version 1 or 2.
            The TLS server the client is connecting to must support either of the two TLS extensions.

    config WOLFSSL_HAVE_TLS_13
        bool "Enable TLS 1.3 in wolfSSL"
        default n
        help
            Enable support for TLS version 1.3 in wolfSSL.

    config WOLFSSL_HAVE_RSA
        bool "Enable RSA in wolfSSL"
        default "y"
        help
            Enables support for key exchange algorithms based on RSA.

    config WOLFSSL_HAVE_SYSTEM_TIME
        bool "Check certificate validity time"
        default y
        help
            Enable certificate validity checks based on current system time.
            This is also needed for the generation of certificates.

    config WOLFSSL_HAVE_ISSUER_NAMES
        bool "Enable issuer name in DecodedCert structure"
        default n
        help
            Enable wolfSSL to include the issuer names in the DecodedCert structure.

    config WOLFSSL_DEBUGGING
        bool "Enable wolfSSL debugging"
        default n
        help
            Enable wolfSSL debugging. Once debugging is enabled sections of code between wolfSSL_Debugging_ON() and
            wolfSSL_Debugging_OFF() will generate detailed debug messages.

    config WOLFSSL_HAVE_CRYPT_BENCHMARK
        bool "Enable wolfSSL benchmark module"
        default n
        help
            Enable wolfSSL cryptography benchmark.

    config WOLFSSL_HAVE_CRYPT_TEST
        bool "Enable wolfSSL test mobule"
        default n
        help
            Enable wolfSSL cryptography benchmark.

endmenu # wolfSSL
```
